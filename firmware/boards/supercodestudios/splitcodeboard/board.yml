## firmware/boards/supercodestudios/splitcodeboard/board.yml
```yaml
#############################################################################
# Copyright (c) 2026 SuperCode Studios
# https://scstudios.tech
# SplitCodeBoard Version 1.0.0
# Licence: GNU Affero General Public License v3.0 only (AGPL-3.0-only)
# SPDX-License-Identifier: AGPL-3.0-only
# Maintainer: SuperCode Studios
#############################################################################
board:
  name: splitcodeboard
  vendor: supercodestudios
  socs:
    - name: nrf52840

# If your board has multiple revisions, specify them here. See
# https://docs.zephyrproject.org/4.1.0/hardware/porting/board_porting.html#multiple-board-revisions

#   revision:
#     format: major.minor.patch
#     default: 2.0.0
#     revisions:
#       - name: 1.0.0
#       - name: 2.0.0
```

## zmk-config/boards/supercodestudios/splitcodeboard/Kconfig.defconfig
```kconfig
#############################################################################
# Copyright (c) 2026 SuperCode Studios
# https://scstudios.tech
# SplitCodeBoard Version 1.0.0
# Licence: GNU Affero General Public License v3.0 only (AGPL-3.0-only)
# SPDX-License-Identifier: AGPL-3.0-only
# Maintainer: SuperCode Studios
#############################################################################

# SplitCodeBoard defaults

if BOARD_SPLITCODEBOARD_LEFT

config ZMK_KEYBOARD_NAME
    default "SplitCodeBoard"

# set left side to central
config ZMK_SPLIT_ROLE_CENTRAL
    default y

# enable split and ble transport
config ZMK_SPLIT
    default y

config ZMK_BLE
    default y

config ZMK_SPLIT_BLE
    default y

# triple split central and 2 peripherals
config ZMK_SPLIT_BLE_CENTRAL_PERIPHERALS
    default 2

# ble only build
config ZMK_USB
    default n

endif # BOARD_SPLITCODEBOARD_LEFT

if BOARD_SPLITCODEBOARD_LEFT || BOARD_SPLITCODEBOARD_RIGHT || BOARD_SPLITCODEBOARD_MACROPAD

# keep ble enabled on all
config ZMK_SPLIT
    default y

config ZMK_BLE
    default y

config ZMK_SPLIT_BLE
    default y

#ble only on all
config ZMK_USB
    default n

endif # BOARD_SPLITCODEBOARD_LEFT || BOARD_SPLITCODEBOARD_RIGHT || BOARD_SPLITCODEBOARD_MACROPAD
```

## zmk-config/boards/supercodestudios/splitcodeboard/Kconfig.splitcodeboard_macropad
```kconfig
# SplitCodeBoard macropad sibling
# Uses nRF52840 (XIAO nRF52840)

config BOARD_SPLITCODEBOARD_MACROPAD
    select SOC_NRF52840_QIAA
```

## zmk-config/boards/supercodestudios/splitcodeboard/board.yml
```yaml
#############################################################################
# Copyright (c) 2026 SuperCode Studios
# https://scstudios.tech
# SplitCodeBoard Version 1.0.0
# Licence:
#############################################################################
board:
  name: splitcodeboard
  vendor: supercodestudios
  socs:
    - name: nrf52840

# If your board has multiple revisions, specify them here. See
# https://docs.zephyrproject.org/4.1.0/hardware/porting/board_porting.html#multiple-board-revisions

#   revision:
#     format: major.minor.patch
#     default: 2.0.0
#     revisions:
#       - name: 1.0.0
#       - name: 2.0.0
```

## zmk-config/boards/supercodestudios/splitcodeboard/splitcodeboard_macropad_defconfig
```kconfig
#############################################################################
# Copyright (c) 2026 SuperCode Studios
# https://scstudios.tech
# SplitCodeBoard Version 1.0.0
# Licence: GNU Affero General Public License v3.0 only (AGPL-3.0-only)
# SPDX-License-Identifier: AGPL-3.0-only
# Maintainer: SuperCode Studios
#############################################################################

# SplitCodeBoard macropad default config

# Enable GPIO
CONFIG_GPIO=y

# Use pinctrl
CONFIG_PINCTRL=y

# BLE-only output
CONFIG_ZMK_BLE=y
# CONFIG_ZMK_USB is not set
```

## zmk-config/boards/supercodestudios/splitcodeboard/splitcodeboard_right_defconfig
```kconfig
#############################################################################
# Copyright (c) 2026 SuperCode Studios
# https://scstudios.tech
# SplitCodeBoard Version 1.0.0
# Licence: GNU Affero General Public License v3.0 only (AGPL-3.0-only)
# SPDX-License-Identifier: AGPL-3.0-only
# Maintainer: SuperCode Studios
#############################################################################

# Enable GPIO
CONFIG_GPIO=y

# Use pinctrl
CONFIG_PINCTRL=y

# Enable I2C for MCP23017 matrix expander
CONFIG_I2C=y

# Polling mode is the most reliable starting point with GPIO expanders
CONFIG_ZMK_KSCAN_MATRIX_POLLING=y
CONFIG_ZMK_KSCAN_DIRECT_POLLING=y

# Rotary encoder support (right side)
CONFIG_EC11=y
CONFIG_EC11_TRIGGER_GLOBAL_THREAD=y

# Enable ZMK outputs
CONFIG_ZMK_BLE=y
# CONFIG_ZMK_USB is not set
```
