///////////////////////////////////////////////////////////////////////////////
// Copyright (c) 2026 SuperCode Studios
// https://scstudios.tech
// SplitCodeBoard Version 1.0.0
// Licence: GNU Affero General Public License v3.0 only (AGPL-3.0-only)
// SPDX-License-Identifier: AGPL-3.0-only
// Maintainer: SuperCode Studios
///////////////////////////////////////////////////////////////////////////////

#include "splitcodeboard.dtsi"
#include "splitcodeboard_left-pinctrl.dtsi"

&i2c0 {
    status = "okay";

    left_io: mcp23017@20 {
        compatible = "microchip,mcp230xx";
        status = "okay";
        reg = <0x20>;
        gpio-controller;
        #gpio-cells = <2>;
        ngpios = <16>;
    };
};

&kscan {
    // Left-half column wiring.
    col-gpios
        = <&gpio0 3 GPIO_ACTIVE_HIGH>
        , <&gpio0 28 GPIO_ACTIVE_HIGH>
        , <&gpio0 29 GPIO_ACTIVE_HIGH>
        , <&left_io 11 GPIO_ACTIVE_HIGH>
        , <&left_io 12 GPIO_ACTIVE_HIGH>
        , <&gpio1 11 GPIO_ACTIVE_HIGH>
        ;
};
