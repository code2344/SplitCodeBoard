///////////////////////////////////////////////////////////////////////////////
// Copyright (c) 2026 SuperCode Studios
// https://scstudios.tech
// SplitCodeBoard Version 1.0.0
// Licence: GNU Affero General Public License v3.0 only (AGPL-3.0-only)
// SPDX-License-Identifier: AGPL-3.0-only
// Maintainer: SuperCode Studios
///////////////////////////////////////////////////////////////////////////////

// SplitCodeBoard macropad sibling overlay

#include "splitcodeboard.dtsi"

&default_transform {
    // Set this to (left columns + right columns).
    // Example: 5 + 5 => 10
    col-offset = <12>;
};

&kscan {
    // Replace with macropad column GPIOs.
    col-gpios
        = <&gpio0 0 GPIO_ACTIVE_HIGH>
        , <&gpio0 0 GPIO_ACTIVE_HIGH>
        ;
};
